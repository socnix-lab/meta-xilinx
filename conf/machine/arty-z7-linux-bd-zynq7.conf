## conf/machine/arty-z7-linux-bd-zynq7.conf
```bitbake
#@TYPE: Machine
#@NAME: artyz-linux-bd-zynq7
#@DESCRIPTION: Machine support for artyz-linux-bd project.
#
# generated base on PetaLinux project: Digilent-Artyz-Linux-BD-v2016.1
#

require conf/machine/include/tune-zynq.inc
require conf/machine/include/machine-xilinx-default.inc
require conf/machine/include/machine-xilinx-board.inc

MACHINE_FEATURES = "ext2 vfat usbhost usbgadget"

SERIAL_CONSOLE = "115200 ttyPS0"

MACHINE_DEVICETREE := " \
		arty-z7-linux-bd/pcw.dtsi \
		arty-z7-linux-bd/pl.dtsi \
		arty-z7-linux-bd/skeleton.dtsi \
		arty-z7-linux-bd/system-conf.dtsi \
		arty-z7-linux-bd/system-top.dts \
		arty-z7-linux-bd/zynq-7000.dtsi \
		"

UBOOT_MACHINE = "zynq_artyz7_defconfig"

EXTRA_IMAGEDEPENDS += "virtual/boot-bin virtual/hdf"

IMAGE_BOOT_FILES += "boot.bin \
	${MACHINE}.dtb \
	fit.itb \
	u-boot-dtb.img \
	download.bit \
	"

# add fitimage and sdimg
IMAGE_CLASSES += "xilinx-fitimage sdcard_image-xilinx"
IMAGE_FSTYPES += "xilinx-fitimage xilinx-sdimg"

MACHINE_ESSENTIAL_EXTRA_RRECOMMENDS += " \
		console-blank \
		i2c-tools \
		"

KERNEL_FEATURES += " \
		bsp/digilent/drm-digilent.scc \
		bsp/digilent/pwm-gpio.scc \
		bsp/xilinx/realtek-phy.scc \
		bsp/xilinx/usb-ulpi-phy.scc \
		"
```

## conf/machine/zybo-linux-bd-zynq7.conf
```bitbake
#@TYPE: Machine
#@NAME: zybo-linux-bd-zynq7
#@DESCRIPTION: Machine support for zybo-linux-bd project.
#
# generated base on ZYBO linux-bd project
#

require conf/machine/include/tune-zynq.inc
require conf/machine/include/machine-xilinx-default.inc
require conf/machine/include/machine-xilinx-board.inc

MACHINE_FEATURES = "ext2 vfat usbhost usbgadget keyboard screen alsa sdio"
SERIAL_CONSOLE = "115200 ttyPS0"

MACHINE_ESSENTIAL_EXTRA_RDEPENDS += "device-tree"

MACHINE_DEVICETREE = " \
		zybo-linux-bd/pcw.dtsi \
		zybo-linux-bd/pl.dtsi \
		zybo-linux-bd/zybo-linux-bd-zynq7.dts \
		"
KERNEL_IMAGETYPE = "zImage"

UBOOT_MACHINE = "zynq_zybo_config"
SPL_BINARY = "spl/boot.bin"

EXTRA_IMAGEDEPENDS += "virtual/bitstream"

IMAGE_BOOT_FILES += "boot.bin \
		${@bb.utils.contains('IMAGE_FSTYPES', 'xilinx-fitimage', 'fit.itb', '${MACHINE}.dtb', d)} \
		bitstream \
		"

# add fitimage
IMAGE_CLASSES += "xilinx-fitimage"
IMAGE_FSTYPES += "xilinx-fitimage"
```

## scripts/lib/image/canned-wks/sdimage-xilinx.wks
```
# short-description: Create Xilinx Zynq SD card image
# long-description: Creates a partitioned SD card image for use with
# Xilinx ZYNQ. Boot files are located in the first vfat partition.

part /boot --source bootimg-partition --ondisk mmcblk --fstype=vfat --label boot --active --align 4096 --size 64 
part / --source rootfs --ondisk mmcblk --fstype=ext4 --label root --align 4096
```
